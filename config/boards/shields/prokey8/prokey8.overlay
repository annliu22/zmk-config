#include <dt-bindings/zmk/matrix_transform.h>
#include "prokey8.dtsi"


&kscan0 {
   col-gpios
   = <&gpio0 20 GPIO_ACTIVE_HIGH>
   , <&gpio0 24 GPIO_ACTIVE_HIGH>
   , <&gpio1 00 GPIO_ACTIVE_HIGH>
   , <&gpio1 06 GPIO_ACTIVE_HIGH>
   ;

   row-gpios
   = <&gpio0 17 (GPIO_ACTIVE_HIGH | GPIO_PULL_DOWN)>
   , <&gpio0 22 (GPIO_ACTIVE_HIGH | GPIO_PULL_DOWN)>
   , <&gpio0 11 (GPIO_ACTIVE_HIGH | GPIO_PULL_DOWN)>
   , <&gpio1 04 (GPIO_ACTIVE_HIGH | GPIO_PULL_DOWN)> 
   ;
};
