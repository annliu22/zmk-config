#include <dt-bindings/zmk/matrix_transform.h>
#include "prokey8.dtsi"


&kscan0 {
   col-gpios
   = <&gpio0 3 (GPIO_ACTIVE_HIGH | GPIO_PULL_UP)>
   ;

   row-gpios
   = <&gpio0 2 GPIO_ACTIVE_HIGH>
   ;
};
